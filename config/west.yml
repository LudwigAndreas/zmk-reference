## config/west.yml
```yaml
manifest:
  remotes:
    - name: zmkfirmware
      url-base: https://github.com/victorlucachi
  projects:
    - name: zmk
      remote: zmkfirmware
      revision: feat/pointers-with-input-processors
      import: app/west.yml
    - name: zmk-pmw3610-driver
      remote: badjeff
      revision: main
  self:
    path: config
```
